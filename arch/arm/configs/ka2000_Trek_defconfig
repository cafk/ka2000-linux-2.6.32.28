## arch/arm/configs/ka2000_Trek_defconfig
```kconfig
CONFIG_EXPERIMENTAL=y
# CONFIG_SWAP is not set
CONFIG_SYSVIPC=y
CONFIG_LOG_BUF_SHIFT=16
CONFIG_GROUP_SCHED=y
CONFIG_RT_GROUP_SCHED=y
CONFIG_NAMESPACES=y
CONFIG_IPC_NS=y
CONFIG_BLK_DEV_INITRD=y
# CONFIG_CC_OPTIMIZE_FOR_SIZE is not set
CONFIG_EMBEDDED=y
# CONFIG_BUG is not set
# CONFIG_VM_EVENT_COUNTERS is not set
CONFIG_MODULES=y
CONFIG_MODULE_UNLOAD=y
# CONFIG_LBDAF is not set
# CONFIG_BLK_DEV_BSG is not set
# CONFIG_IOSCHED_AS is not set
# CONFIG_IOSCHED_CFQ is not set
CONFIG_ARCH_KA2000=y
CONFIG_KA2000_KERNEL_INITRD_PHYS=0x00500000
CONFIG_KA2000_CHIP_VERSION=0xD
CONFIG_KA2000_POWER_SLEEP_ENABLE=y
# CONFIG_KA2000_DECOMPRESS_ENABLE is not set
# CONFIG_KA2000_WITH_RESISTER is not set
CONFIG_KA2000_CUST_TREK=y
# CONFIG_ARM_THUMB is not set
CONFIG_CPU_CACHE_ROUND_ROBIN=y
CONFIG_PREEMPT=y
CONFIG_AEABI=y
# CONFIG_OABI_COMPAT is not set
CONFIG_DEFAULT_MMAP_MIN_ADDR=16384
CONFIG_CMDLINE="root=/dev/ram0 rw console=ttyS0,38400n8 mem=32M initrd=0x500000,3M"
CONFIG_CORE_DUMP_DEFAULT_ELF_HEADERS=y
CONFIG_NET=y
CONFIG_PACKET=y
CONFIG_PACKET_MMAP=y
CONFIG_UNIX=y
CONFIG_INET=y
CONFIG_INET_IPCOMP=y
# CONFIG_INET_DIAG is not set
# CONFIG_IPV6 is not set
CONFIG_NETWORK_SECMARK=y
CONFIG_NETFILTER=y
# CONFIG_NETFILTER_ADVANCED is not set
# CONFIG_NF_CONNTRACK_PROC_COMPAT is not set
CONFIG_CFG80211=y
# CONFIG_CFG80211_DEFAULT_PS is not set
CONFIG_LIB80211=y
CONFIG_MAC80211=y
CONFIG_UEVENT_HELPER_PATH=""
# CONFIG_FIRMWARE_IN_KERNEL is not set
CONFIG_MTD=y
CONFIG_MTD_PARTITIONS=y
CONFIG_MTD_M25P80=y
CONFIG_MTD_BLOCK2MTD=y
CONFIG_BLK_DEV_LOOP=y
CONFIG_BLK_DEV_RAM=y
CONFIG_BLK_DEV_RAM_COUNT=1
# CONFIG_MISC_DEVICES is not set
CONFIG_NETDEVICES=y
# CONFIG_NETDEV_1000 is not set
# CONFIG_NETDEV_10000 is not set
CONFIG_WLAN_80211=y
CONFIG_LIBERTAS=m
CONFIG_LIBERTAS_SDIO=m
# CONFIG_INPUT is not set
# CONFIG_SERIO is not set
# CONFIG_VT is not set
# CONFIG_DEVKMEM is not set
CONFIG_PWM_KA2000=y
CONFIG_SERIAL_KA2000=y
CONFIG_SERIAL_KA2000_CONSOLE=y
# CONFIG_LEGACY_PTYS is not set
# CONFIG_HW_RANDOM is not set
CONFIG_MOVTION_SENSOR=m
CONFIG_SPI=y
CONFIG_SPI_BITBANG=y
CONFIG_SPI_KA2000=y
# CONFIG_HWMON is not set
# CONFIG_USB_SUPPORT is not set
CONFIG_MMC=y
CONFIG_SDSWITCH_KA2000=m
CONFIG_MMC_KA2000=m
CONFIG_SDIO_KA2000=m
# CONFIG_FILE_LOCKING is not set
# CONFIG_DNOTIFY is not set
# CONFIG_INOTIFY_USER is not set
CONFIG_MSDOS_FS=y
CONFIG_VFAT_FS=y
# CONFIG_PROC_PAGE_MONITOR is not set
# CONFIG_SYSFS is not set
CONFIG_JFFS2_FS=y
CONFIG_PARTITION_ADVANCED=y
CONFIG_BSD_DISKLABEL=y
CONFIG_LDM_PARTITION=y
CONFIG_LDM_DEBUG=y
CONFIG_NLS_CODEPAGE_437=y
CONFIG_NLS_CODEPAGE_950=y
CONFIG_NLS_ASCII=y
CONFIG_NLS_ISO8859_1=y
CONFIG_NLS_UTF8=y
# CONFIG_ENABLE_WARN_DEPRECATED is not set
# CONFIG_ENABLE_MUST_CHECK is not set
# CONFIG_ARM_UNWIND is not set
CONFIG_SECURITY_FILE_CAPABILITIES=y
CONFIG_CRYPTO_AUTHENC=y
CONFIG_CRYPTO_CBC=y
CONFIG_CRYPTO_HMAC=y
CONFIG_CRYPTO_MD5=y
CONFIG_CRYPTO_SHA1=y
CONFIG_CRC7=y
```

## arch/arm/mach-ka2000/Kconfig
```kconfig
if ARCH_KA2000

menu "KeyASIC Implementations"

comment "KeyASIC KA2000 Core Type"

config ARCH_KA2000x
	default y
	bool "KeyASIC KA2000 based system"

comment "KeyASIC KA2000 Board Type"

config MACH_KA2000_EVM
	bool "KeyASIC KA2000 EVM"
	depends on ARCH_KA2000x
	default y

	help
	  Configure this option to specify the whether the board used
	  for development is a KA2000 EVM

config KA2000_KERNEL_ZRELADDR
	hex "ZRELADDR location for the Kernel"
	default "0x00208000"
	help
	  Provide ZRELADDR location for the kernel. The value should match with
	  default + SDRAM_OFFSET 0x00208000.

config KA2000_KERNEL_PARAMS_PHYS
	hex "PARAMS_PHYS location for the Kernel"
	default "0x00200100"
	help
	  Provide PARAMS_PHYS location for the kernel. The value should match
	  with default + SDRAM_OFFSET 0x00200100.

config KA2000_KERNEL_INITRD_PHYS
	hex "INITRD_PHYS location"
	default "0x00400000"
	help
	  Provide INITRD_PHYS location for the kernel. The value should match
	  with default + SDRAM_OFFSET 0x00400000.

config KA2000_CHIP_VERSION
	hex "KA2000 Chip Version (A,D)"
    default "A"

config KA2000_PRINTK_ENABLE
	default y
	bool "KA2000 Enable Printk"

config KA2000_POWER_SLEEP_ENABLE
	default n
	bool "KA2000 Enable Power Sleep after bootup"

config KA2000_DECOMPRESS_ENABLE
	default y
	bool "KA2000 Enable COMPRESS"

config KA2000_12M_FPGA_TEST
	default n
	bool "KA2000 Set Clock 12MHz for FPGA testing."


config KA2000_WITH_RESISTER
	default y
	bool "KA2000 Switch driver with resister or not"

config KA2000_PWM_ENABLE
	default y
	bool "KA2000 Enable PWM Buzzer"

choice
	prompt "Customer specified"
	default KA2000_CUST_NONE

config KA2000_CUST_NONE
	bool "No specified design."
	help
	  No specified or customized design."

config KA2000_CUST_TREK
	bool "Specified for Trek"
	help
	  Specified for Trek.
endchoice

choice
	prompt "KA2000 clock setting"
	depends on !KA2000_CUST_TREK
	default PLL_CPU_HCLK_192_96_96

config PLL_CPU_HCLK_24_24_24
    bool "pll_cpu_hclk_24_24_24"
	help
	  pll_cpu_hclk_24_24_24

config PLL_CPU_HCLK_96_48_48
    bool "pll_cpu_hclk_96_48_48"
	help
	  pll_cpu_hclk_96_48_48

config PLL_CPU_HCLK_192_96_96
    bool "pll_cpu_hclk_192_96_96"
	help
	  pll_cpu_hclk_192_96_96

config PLL_CPU_HCLK_192_192_96
    bool "pll_cpu_hclk_192_192_96"
	help
	  pll_cpu_hclk_192_192_96

config PLL_CPU_HCLK_96_96_96
    bool "pll_cpu_hclk_96_96_96"
	help
	  pll_cpu_hclk_96_96_96

config PLL_CPU_HCLK_192_48_48
    bool "pll_cpu_hclk_192_48_48"
	help
	  pll_cpu_hclk_192_48_48

config PLL_CPU_HCLK_192_96_48
    bool "pll_cpu_hclk_192_96_48"
	help
	  pll_cpu_hclk_192_96_48

config PLL_CPU_HCLK_192_24_24
    bool "pll_cpu_hclk_192_24_24"
	help
	  pll_cpu_hclk_192_24_24

config PLL_CPU_HCLK_210_210_105
    bool "pll_cpu_hclk_210_210_105"
	help
	  pll_cpu_hclk_210_210_105

config PLL_CPU_HCLK_156_78_78
    bool "pll_cpu_hclk_156_78_78"
	help
	  pll_cpu_hclk_156_78_78

config PLL_CPU_HCLK_12_12_12_FPGA
    bool "pll_cpu_hclk_12_12_12_FPGA"
	help
	  pll_cpu_hclk_12_12_12_FPGA

config PLL_CPU_HCLK_96_96_48
    bool "pll_cpu_hclk_96_96_48"
	help
	  pll_cpu_hclk_96_96_48
endchoice

endmenu

endif
```

## drivers/net/wireless/wlan_src/Kconfig
```kconfig
config WLAN_SRC 
	tristate "Marvell WLAN SRC Driver for 8787"
	depends on CFG80211
	select LIB80211
	---help---
	  This adds support for wireless adapters based on Marvell
	  802.11n chipsets.

	  If you choose to build it as a module, it will be called
	  mwifiex.

config WLAN_SRC_SDIO
	tristate "Marvell WLAN  SDIO SRC Driver for SD8787"
	depends on WLAN_SRC && MMC
	select FW_LOADER
	---help---
	  This adds support for wireless adapters based on Marvell
	  8787 chipset with SDIO interface.

	  If you choose to build it as a module, it will be called
	  mwifiex_sdio.
```
